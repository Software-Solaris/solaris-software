## solaris-v0.1/sdkconfig.defaults
```kconfig
# Consola por USB Serial/JTAG (ESP32-S3 → /dev/ttyACM0)
CONFIG_ESP_CONSOLE_NONE=n
CONFIG_ESP_CONSOLE_UART_DEFAULT=n
CONFIG_ESP_CONSOLE_UART=n
CONFIG_ESP_CONSOLE_USB_CDC=n
CONFIG_ESP_CONSOLE_USB_SERIAL_JTAG=y

# Verbosidad bootloader y app
CONFIG_BOOTLOADER_LOG_LEVEL=3
CONFIG_LOG_DEFAULT_LEVEL=3
```
